VERSION ""

NS_ :

BS_:

BU_:

BO_ 2147483914 MCU_FUEL_CELL_CURRENTS: 4 MCU
 SG_ FUEL_CELL_OUTPUT_CURRENT : 16|16@1- (0.01,0) [-327.68|327.67] "A" Vector__XXX
 SG_ FUEL_CELL_STACK_OUTPUT_CURRENT : 0|16@1- (0.01,0) [-327.68|327.67] "A" Vector__XXX

BO_ 2147483905 MCU_FAULTS: 8 MCU
 SG_ ERROR_AB_C_HIGH : 35|1@1+ (1,0) [0|1] "" Vector__XXX
 SG_ ERROR_AB_C_LOW : 34|1@1+ (1,0) [0|1] "" Vector__XXX
 SG_ ERROR_AB_V_HIGH : 33|1@1+ (1,0) [0|1] "" Vector__XXX
 SG_ ERROR_AB_V_LOW : 32|1@1+ (1,0) [0|1] "" Vector__XXX
 SG_ ERROR_MC_C_HIGH : 27|1@1+ (1,0) [0|1] "" Vector__XXX
 SG_ ERROR_MC_C_LOW : 26|1@1+ (1,0) [0|1] "" Vector__XXX
 SG_ ERROR_MC_V_HIGH : 25|1@1+ (1,0) [0|1] "" Vector__XXX
 SG_ ERROR_MC_V_LOW : 24|1@1+ (1,0) [0|1] "" Vector__XXX
 SG_ ERROR_SC_C_HIGH : 19|1@1+ (1,0) [0|1] "" Vector__XXX
 SG_ ERROR_SC_C_LOW : 18|1@1+ (1,0) [0|1] "" Vector__XXX
 SG_ ERROR_SC_V_HIGH : 17|1@1+ (1,0) [0|1] "" Vector__XXX
 SG_ ERROR_SC_V_LOW : 16|1@1+ (1,0) [0|1] "" Vector__XXX
 SG_ ERROR_FC_C_HIGH : 11|1@1+ (1,0) [0|1] "" Vector__XXX
 SG_ ERROR_FC_C_LOW : 10|1@1+ (1,0) [0|1] "" Vector__XXX
 SG_ ERROR_FC_V_HIGH : 9|1@1+ (1,0) [0|1] "" Vector__XXX
 SG_ ERROR_FC_V_LOW : 8|1@1+ (1,0) [0|1] "" Vector__XXX
 SG_ EMERGENCY_HYDROGEN_LEAKAGE_VOLTA : 3|1@1+ (1,0) [0|1] "" Vector__XXX
 SG_ EMERGENCY_LEAKAGE_DETECTED : 2|1@1+ (1,0) [0|1] "" Vector__XXX
 SG_ EMERGENCY_DEAD_MANS_SWITCH : 1|1@1+ (1,0) [0|1] "" Vector__XXX
 SG_ EMERGENCY_SWITCH : 0|1@1+ (1,0) [0|1] "" Vector__XXX

BA_DEF_ SG_  "SystemSignalLongSymbol" STRING ;
BA_DEF_DEF_  "SystemSignalLongSymbol" "";
BA_ "SystemSignalLongSymbol" SG_ 2147483905 EMERGENCY_HYDROGEN_LEAKAGE_VOLTA "EMERGENCY_HYDROGEN_LEAKAGE_VOLTAGE";
VAL_ 2147483905 ERROR_AB_C_HIGH 0 "FALSE" 1 "TRUE" ;
VAL_ 2147483905 ERROR_AB_C_LOW 0 "FALSE" 1 "TRUE" ;
VAL_ 2147483905 ERROR_AB_V_HIGH 0 "FALSE" 1 "TRUE" ;
VAL_ 2147483905 ERROR_AB_V_LOW 0 "FALSE" 1 "TRUE" ;
VAL_ 2147483905 ERROR_MC_C_HIGH 0 "FALSE" 1 "TRUE" ;
VAL_ 2147483905 ERROR_MC_C_LOW 0 "FALSE" 1 "TRUE" ;
VAL_ 2147483905 ERROR_MC_V_HIGH 0 "FALSE" 1 "TRUE" ;
VAL_ 2147483905 ERROR_MC_V_LOW 0 "FALSE" 1 "TRUE" ;
VAL_ 2147483905 ERROR_SC_C_HIGH 0 "FALSE" 1 "TRUE" ;
VAL_ 2147483905 ERROR_SC_C_LOW 0 "FALSE" 1 "TRUE" ;
VAL_ 2147483905 ERROR_SC_V_HIGH 0 "FALSE" 1 "TRUE" ;
VAL_ 2147483905 ERROR_SC_V_LOW 0 "FALSE" 1 "TRUE" ;
VAL_ 2147483905 ERROR_FC_C_HIGH 0 "FALSE" 1 "TRUE" ;
VAL_ 2147483905 ERROR_FC_C_LOW 0 "FALSE" 1 "TRUE" ;
VAL_ 2147483905 ERROR_FC_V_HIGH 0 "FALSE" 1 "TRUE" ;
VAL_ 2147483905 ERROR_FC_V_LOW 0 "FALSE" 1 "TRUE" ;
VAL_ 2147483905 EMERGENCY_LEAKAGE_DETECTED 0 "FALSE" 1 "TRUE" ;
VAL_ 2147483905 EMERGENCY_DEAD_MANS_SWITCH 0 "FALSE" 1 "TRUE" ;
VAL_ 2147483905 EMERGENCY_SWITCH 0 "FALSE" 1 "TRUE" ;
